## 01_App_Button/build/Kconfig/arch/Kconfig
```kconfig
# Load Zephyr Arch Kconfig descriptions.
osource "D:/zephyr_workspace/zephyrproject/zephyr/arch/rx/Kconfig"
osource "D:/zephyr_workspace/zephyrproject/zephyr/arch/x86/Kconfig"
osource "D:/zephyr_workspace/zephyrproject/zephyr/arch/xtensa/Kconfig"
osource "D:/zephyr_workspace/zephyrproject/zephyr/arch/sparc/Kconfig"
osource "D:/zephyr_workspace/zephyrproject/zephyr/arch/riscv/Kconfig"
osource "D:/zephyr_workspace/zephyrproject/zephyr/arch/posix/Kconfig"
osource "D:/zephyr_workspace/zephyrproject/zephyr/arch/mips/Kconfig"
osource "D:/zephyr_workspace/zephyrproject/zephyr/arch/arm64/Kconfig"
osource "D:/zephyr_workspace/zephyrproject/zephyr/arch/arm/Kconfig"
osource "D:/zephyr_workspace/zephyrproject/zephyr/arch/arc/Kconfig"
```

## 01_App_Button/build/Kconfig/boards/Kconfig
```kconfig
# Load Zephyr board Kconfig descriptions.
osource "D:/zephyr_workspace/zephyrproject/zephyr/boards/st/nucleo_f401re/Kconfig"
```

## 01_App_Button/build/Kconfig/boards/Kconfig.defconfig
```kconfig
# Load Zephyr board defconfig descriptions.
osource "D:/zephyr_workspace/zephyrproject/zephyr/boards/st/nucleo_f401re/Kconfig.defconfig"
```

## 01_App_Button/build/Kconfig/boards/Kconfig.nucleo_f401re
```kconfig
# Load board Kconfig descriptions.
osource "D:/zephyr_workspace/zephyrproject/zephyr/boards/st/nucleo_f401re/Kconfig.nucleo_f401re"
```

## modules/button/drivers/button/Kconfig
```kconfig
config CUSTOM_BUTTON
	bool "Custom button driver"
	default y
	depends on DT_HAS_CUSTOM_BUTTON_ENABLED
	select GPIO
	help
	  Enable the custom button driver.
```

## modules/button/dts/bindings/input/custom,button.yaml
```yaml
description: Custom button

compatible: "custom,button"

properties:
  pin:
    type: phandle
    required: true
```
